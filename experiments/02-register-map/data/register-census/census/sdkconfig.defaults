## experiments/02-register-map/data/register-census/census/sdkconfig.defaults
```kconfig
CONFIG_IDF_TARGET="esp32"
CONFIG_ESPTOOLPY_FLASHSIZE_2MB=y
CONFIG_FREERTOS_UNICORE=y
CONFIG_FREERTOS_HZ=1000
CONFIG_ESP_DEFAULT_CPU_FREQ_MHZ_240=y
CONFIG_ESP_CONSOLE_UART_DEFAULT=y
CONFIG_LOG_DEFAULT_LEVEL_WARN=y
CONFIG_BOOTLOADER_LOG_LEVEL_WARN=y
CONFIG_ESP_SYSTEM_PANIC_PRINT_REBOOT=y
CONFIG_ESP_MAIN_TASK_STACK_SIZE=8192
# CONFIG_ESP_WIFI_AMPDU_TX_ENABLED is not set
# CONFIG_ESP_WIFI_AMPDU_RX_ENABLED is not set
```

## firmware/main/Kconfig.projbuild
```kconfig
menu "D8 TX"

config D8_BENCH
    bool "Bench modes (TONE, ALT, RETUNE, PKT, HOP n_slots>0, keyed TCAP)"
    default n
    help
        Off (default, release build): the keying commands are LINK, BIND and continuous HOP 0; with S, STOP/U, FOFS,
        ARMOK, INFO, STAT, TLM, TLMX, TID, ID, PING, STICKS and receive-only TCAP. TONE, ALT, RETUNE, PKT, HOP n_slots>0
        and keyed TCAP are not compiled in and reply "ERR bench-only" (protocol v1: "ERR bench-only bench build required").
        On: those fixed-channel / CW bench modes compile in. They require an explicit pwr. They are a separate regulatory
        case from LINK (47 CFR 15.249 fixed channel vs 15.247 frequency hopping); INFO reports bench=1.

config D8_PWR_MAX
    int "Maximum pwr code accepted by any keying command (raw PBUS(5,1) code, not dBm)"
    range 0 127
    default 127
    help
        Compile-time cap applied to the pwr argument of LINK, BIND, HOP and (bench build) TONE/ALT/PKT/TCAP.
        Reported in INFO as pwr_max=. No calibration to dBm exists.

endmenu
```

## tools/txeng/sdkconfig.defaults
```kconfig
CONFIG_IDF_TARGET="esp32"
CONFIG_ESPTOOLPY_FLASHSIZE_2MB=y
CONFIG_FREERTOS_UNICORE=y
CONFIG_FREERTOS_HZ=1000
CONFIG_ESP_DEFAULT_CPU_FREQ_MHZ_240=y
CONFIG_ESP_CONSOLE_UART_CUSTOM=y
CONFIG_ESP_CONSOLE_UART_CUSTOM_NUM_0=y
CONFIG_ESP_CONSOLE_UART_BAUDRATE=921600
CONFIG_LOG_DEFAULT_LEVEL_WARN=y
CONFIG_BOOTLOADER_LOG_LEVEL_WARN=y
CONFIG_ESP_SYSTEM_PANIC_PRINT_REBOOT=y
CONFIG_ESP_MAIN_TASK_STACK_SIZE=8192
CONFIG_ESP_TASK_WDT_INIT=n
# CONFIG_ESP_WIFI_AMPDU_TX_ENABLED is not set
# CONFIG_ESP_WIFI_AMPDU_RX_ENABLED is not set
```
